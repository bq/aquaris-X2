qcom,zangya_zangyapro_battery_profile_jan2nd2018 {
	qcom, = <24>;
	qcom,max-voltage-uv = <4400000>;
	qcom,nom-batt-capacity-mah = <3100>;
	qcom,fastchg-current-ma = <2200>;
	qcom,fg-cc-cv-threshold-mv = <4390>;
	qcom,batt-id-kohm = <47>;
	qcom,battery-beta = <3435>;
	qcom,battery-type = "zangya_zangyapro_battery_profile_jan2nd2018";
	qcom,checksum = <0xC79D>;
	qcom,gui-version = "PM660GUI - 0.0.0.45";
	qcom,fg-profile-data = [
		 D0 1F 56 05
		 A7 0A 2B 06
		 EC 1C B5 01
		 7D 04 0C 0A
		 A6 17 B9 23
		 AF 44 05 5A
		 7F 00 00 00
		 11 00 00 00
		 00 00 50 C5
		 FC 07 9D C3
		 1D 00 08 00
		 23 F2 3C 07
		 22 06 46 01
		 3B 05 D8 0B
		 AC 06 E7 33
		 27 06 09 20
		 27 00 14 00
		 FB 1F 3A 05
		 CB 0A F8 05
		 BA 1C 11 03
		 E7 15 48 12
		 5C 18 F0 23
		 D9 4D 44 5B
		 6B 00 00 00
		 0E 00 00 00
		 00 00 C8 D5
		 BD BB C8 CA
		 17 00 00 00
		 00 01 3C 07
		 EF 06 7E F2
		 E4 E5 61 03
		 7A 07 BD 1A
		 AB 33 CC FF
		 07 10 00 00
		 11 0C 66 46
		 17 00 40 00
		 E7 01 0A FA
		 FF 00 00 00
		 00 00 00 00
		 00 00 00 00
		 00 00 00 00
		 00 00 00 00
		 00 00 00 00
		 00 00 00 00
		 00 00 00 00
		 00 00 00 00
		 00 00 00 00
		 00 00 00 00
		 00 00 00 00
		 00 00 00 00
		 00 00 00 00
		 00 00 00 00
		 00 00 00 00
		 00 00 00 00
		 00 00 00 00
		 00 00 00 00
	];
};
